U8GLIB_SH1106_128X64 lcd(U8G_I2C_OPT_DEV_0 | U8G_I2C_OPT_FAST);

const byte LCD_NONE = 0;
const byte LCD_STARTUP = 1;
const byte LCD_CHECK = 2;
const byte LCD_NORMAL = 3;
const byte LCD_STANDBY = 4;
byte lcdState = LCD_NONE;

const int NUM_SENSOR = 4;
int curSensor = 0;
const byte NEXT_SENSOR_PIN = 23;
const byte PREV_SENSOR_PIN = 22;
const byte STANDBY_PIN = 24;
Bounce nextSensor_debounce = Bounce();
Bounce prevSensor_debounce = Bounce();
Bounce standby_debounce = Bounce();

float LCD_powerVal[NUM_SENSOR] = {
  -1};
float LCD_currentVal[NUM_SENSOR] = {
  -1};
float LCD_voltageVal[NUM_SENSOR] = {
  -1};
float LCD_tempVal[NUM_SENSOR] = {
  -1};
char LCD_powerStr[10] = "\0";
char LCD_currentStr[10] = "\0";
char LCD_voltageStr[10] = "\0";
char LCD_tempStr[10] = "\0";
unsigned long LCD_lastTimeUpdate[NUM_SENSOR][4] = {
  0};
const unsigned long LCD_CHECK_TIME_POWER = 5000;
const unsigned long LCD_CHECK_TIME_OTHER = 20000;
Mesh24Timer LCD_checkTimer = Mesh24Timer(10000);
Mesh24Timer LCD_standByTimer = Mesh24Timer(30000);

const byte LCD_splash_width = 128;
const byte LCD_splash_height = 64;
const extern byte LCD_splash_bits[] U8G_PROGMEM;

byte LCD_checkState = 0;
const byte LCDCHECK_RTC = 0;
const byte LCDCHECK_RF = 1;
const byte LCDCHECK_SD = 2;
const byte LCDCHECK_ETHERNET = 3;

void a_inline LCD_draw();
void a_inline LCD_doDraw() {
  switch(lcdState) {
  case LCD_STARTUP:
    lcd.drawXBMP(0, 0, LCD_splash_width, LCD_splash_height, LCD_splash_bits);
    break;
  case LCD_CHECK:
    {
      lcd.setFont(u8g_font_courB10r);
      lcd.setFontPosTop();
      byte lineH = lcd.getFontAscent() - lcd.getFontDescent();
      byte curY = 0;
      lcd.drawStrP(2, curY, (const u8g_pgm_uint8_t*)PSTR("Checking..."));
      curY += lineH * 1.2;
      lcd.setFont(u8g_font_courB08r);
      lcd.setFontPosTop();
      if(LCD_checkState & 1<<LCDCHECK_RTC) {
        lcd.drawStrP(2, curY, (const u8g_pgm_uint8_t*)PSTR("R T C       ok"));
      }
      curY += lineH;
      if(LCD_checkState & 1<<LCDCHECK_RF) {
        lcd.drawStrP(2, curY, (const u8g_pgm_uint8_t*)PSTR("R F         ok"));
      }
      curY += lineH;
      if(LCD_checkState & 1<<LCDCHECK_SD) {
        lcd.drawStrP(2, curY, (const u8g_pgm_uint8_t*)PSTR("S D         ok"));
      }
      curY += lineH;
      if(LCD_checkState & 1<<LCDCHECK_ETHERNET) {
        lcd.drawStrP(2, curY, (const u8g_pgm_uint8_t*)PSTR("E T H E R   ok"));
      }
      curY += lineH;
    }
    break;
  case LCD_NORMAL:
    {
      lcd.setFont(u8g_font_courB08r);
      lcd.setFontPosTop();
      byte lineH = lcd.getFontAscent() - lcd.getFontDescent();
      byte curY = 0, curX = 0;

      if(curSensor == 0) {
        lcd.drawStrP(curX, curY, (const u8g_pgm_uint8_t*)PSTR(" T o t a l :"));
      }
      else {
        lcd.drawStrP(curX, curY, (const u8g_pgm_uint8_t*)PSTR(" ID : "));
        curX += lcd.getStrWidthP((u8g_pgm_uint8_t*)PSTR(" ID : "));
        char str[3];
        itoa(curSensor, str, 10);
        lcd.drawStr(curX, curY, str);
      }
      curY += lineH;

      lcd.setFont(u8g_font_courB10);
      lcd.setFontPosTop();
      lineH = lcd.getFontAscent() - lcd.getFontDescent();
      curX = 0;
      lcd.drawStrP(curX, curY, (const u8g_pgm_uint8_t*)PSTR("P: "));
      curX += lcd.getStrWidthP((u8g_pgm_uint8_t*)PSTR("P: ")) + 2;
      lcd.drawStr(curX, curY, LCD_powerStr);
      curX += lcd.getStrWidth(LCD_powerStr);
      lcd.drawStrP(curX, curY, (const u8g_pgm_uint8_t*)PSTR(" W"));
      curY += lineH;

      curX = 0;
      lcd.drawStrP(curX, curY, (const u8g_pgm_uint8_t*)PSTR("I: "));
      curX += lcd.getStrWidthP((u8g_pgm_uint8_t*)PSTR("I: ")) + 2;
      lcd.drawStr(curX, curY, LCD_currentStr);
      curX += lcd.getStrWidth(LCD_currentStr);
      lcd.drawStrP(curX, curY, (const u8g_pgm_uint8_t*)PSTR(" A"));
      curY += lineH;

      curX = 0;
      lcd.drawStrP(curX, curY, (const u8g_pgm_uint8_t*)PSTR("U: "));
      curX += lcd.getStrWidthP((u8g_pgm_uint8_t*)PSTR("U: ")) + 2;
      lcd.drawStr(curX, curY, LCD_voltageStr);
      curX += lcd.getStrWidth(LCD_voltageStr);
      lcd.drawStrP(curX, curY, (const u8g_pgm_uint8_t*)PSTR(" V"));
      curY += lineH;

      curX = 0;
      lcd.drawStrP(curX, curY, (const u8g_pgm_uint8_t*)PSTR("T: "));
      curX += lcd.getStrWidthP((u8g_pgm_uint8_t*)PSTR("T: ")) + 2;
      lcd.drawStr(curX, curY, LCD_tempStr);
      curX += lcd.getStrWidth(LCD_tempStr);
      lcd.drawStrP(curX, curY, (const u8g_pgm_uint8_t*)PSTR(" \xB0""C"));
      curY += lineH;
    }
    break;
  }
}

void totalNewVal();
void a_inline LCD_newPower(byte bNum, float val) {
  if(lcdState == LCD_STANDBY) return;
  LCD_powerVal[bNum] = val;
  LCD_lastTimeUpdate[bNum][0] = millis();
  if(bNum > 0 && curSensor == 0) {
    LCD_lastTimeUpdate[0][0] = millis();
    totalNewVal();
  }
  if(bNum == curSensor) LCD_draw();
}
void a_inline LCD_newCurrent(byte bNum, float val) {
  if(lcdState == LCD_STANDBY) return;
  LCD_currentVal[bNum] = val;
  LCD_lastTimeUpdate[bNum][1] = millis();
  if(bNum > 0 && curSensor == 0) {
    LCD_lastTimeUpdate[0][1] = millis();
    totalNewVal();
  }
  if(bNum == curSensor) LCD_draw();
}
void a_inline LCD_newVoltage(byte bNum, float val) {
  if(lcdState == LCD_STANDBY) return;
  LCD_voltageVal[bNum] = val;
  LCD_lastTimeUpdate[bNum][2] = millis();
  if(bNum > 0 && curSensor == 0) {
    LCD_lastTimeUpdate[0][2] = millis();
    totalNewVal();
  }
  if(bNum == curSensor) LCD_draw();
}
void a_inline LCD_newTemp(byte bNum, float val) {
  if(lcdState == LCD_STANDBY) return;
  LCD_tempVal[bNum] = val;
  LCD_lastTimeUpdate[bNum][3] = millis();
  if(bNum > 0 && curSensor == 0) {
    LCD_lastTimeUpdate[0][3] = millis();
    totalNewVal();
  }
  if(bNum == curSensor) LCD_draw();
}

void totalNewVal() {
  if(lcdState == LCD_STANDBY) return;
  float val = 0, tmp;
  for(byte i = 1; i < NUM_SENSOR; i++) {
    tmp = LCD_powerVal[i];
    if(tmp != -1) {
      val += tmp;
    }
  }
  if(val != 0)
    LCD_newPower(0, val);
  else
    LCD_newPower(0, -1);

  val = 0;
  for(byte i = 1; i < NUM_SENSOR; i++) {
    tmp = LCD_currentVal[i];
    if(tmp != -1) {
      val += tmp;
    }
  }
  if(val != 0)
    LCD_newCurrent(0, val);
  else
    LCD_newCurrent(0, -1);

  byte cnt = 0;
  val = 0;
  for(byte i = 1; i < NUM_SENSOR; i++) {
    tmp = LCD_voltageVal[i];
    if(tmp != -1) {
      val += tmp;
      cnt++;
    }
  }
  if(cnt != 0)
    LCD_newVoltage(0, val / cnt);
  else
    LCD_newVoltage(0, -1);

  cnt = 0;
  val = 0;
  for(byte i = 1; i < NUM_SENSOR; i++) {
    tmp = LCD_tempVal[i];
    if(tmp != -1) {
      val += tmp;
      cnt++;
    }
  }
  if(cnt != 0)
    LCD_newTemp(0, val / cnt);
  else
    LCD_newTemp(0, -1);
}

const unsigned int sensorMap[NUM_SENSOR] PROGMEM = {
  0xFFFF, (2<<8 | 0), 0xFFFF, 0xFFFF,
};
unsigned int a_inline getSensorNum(byte slaveID, byte sensorID) {
  if(lcdState == LCD_STANDBY) return 0;
  unsigned int tmp = slaveID << 8 | sensorID;
  for(unsigned int i = 0; i < NUM_SENSOR; i++) {
    if(pgm_read_word(&sensorMap[i]) == tmp) return i;
  }
  return -1;
}

void a_inline LCD_newCheckState(byte check) {
  LCD_checkState |= 1<<check;
  LCD_draw();
}

void a_inline LCD_draw() {
  if(lcdState == LCD_STANDBY) return;
  if(lcdState == LCD_NORMAL) {
    float pVal = LCD_powerVal[curSensor];
    float iVal = LCD_currentVal[curSensor];
    float uVal = LCD_voltageVal[curSensor];
    float tVal = LCD_tempVal[curSensor];
    if(pVal != -1) {
      dtostrf(pVal, 4, 2, LCD_powerStr);
    }
    else {
      strcpy_P(LCD_powerStr, PSTR("  -  "));
    }
    if(iVal != -1) {
      dtostrf(iVal, 4, 2, LCD_currentStr);
    }
    else {
      strcpy_P(LCD_currentStr, PSTR("  -  "));
    }
    if(uVal != -1) {
      dtostrf(uVal, 4, 2, LCD_voltageStr);
    }
    else {
      strcpy_P(LCD_voltageStr, PSTR("  -  "));
    }
    if(tVal != -1) {
      dtostrf(tVal, 4, 2, LCD_tempStr);
    }
    else {
      strcpy_P(LCD_tempStr, PSTR("  -  "));
    }
  }
  lcd.firstPage();
  do {
    LCD_doDraw();
  }
  while(lcd.nextPage());
}

void a_inline LCD_switchState(byte newState) {
  switch(newState) {
  case LCD_NORMAL:
    for(byte i = 0; i < NUM_SENSOR; i++) {
      LCD_newPower(i, -1);
      LCD_newCurrent(i, -1);
      LCD_newVoltage(i, -1);
      LCD_newTemp(i, -1);
    }
    curSensor = 0;
    break;
  case LCD_STANDBY:
    lcd.firstPage();
    do {
      lcd.drawXBMP(0, 0, LCD_splash_width, LCD_splash_height, LCD_splash_bits);
    }
    while(lcd.nextPage());
    lcdState = newState;
    return;
  }
  lcdState = newState;
  LCD_draw();
}

void a_inline LCD_loop() {
  standby_debounce.update();
  if(standby_debounce.fell()) {
    if(lcdState == LCD_STANDBY) {
      LCD_switchState(LCD_NORMAL);
      LCD_standByTimer.begin();
    }
    else {
      LCD_switchState(LCD_STANDBY);
      return;
    }
  }
  if(LCD_standByTimer.isDue()) {
    LCD_switchState(LCD_STANDBY);
    return;
  }
  nextSensor_debounce.update();
  prevSensor_debounce.update();
  if(nextSensor_debounce.fell()) {
    curSensor++;
    if(curSensor >= NUM_SENSOR) curSensor = 0;
    LCD_draw();
    LCD_standByTimer.begin();
  }
  else if(prevSensor_debounce.fell()) {
    curSensor--;
    if(curSensor < 0) curSensor = NUM_SENSOR - 1;
    LCD_draw();
    LCD_standByTimer.begin();
  }
  if(LCD_checkTimer.isDue()) {
    unsigned long curTime = millis();
    for(byte i = 0; i < NUM_SENSOR; i++) {
      if(curTime - LCD_lastTimeUpdate[i][0] > LCD_CHECK_TIME_POWER) LCD_newPower(i, -1);
      if(curTime - LCD_lastTimeUpdate[i][1] > LCD_CHECK_TIME_OTHER) LCD_newCurrent(i, -1);
      if(curTime - LCD_lastTimeUpdate[i][2] > LCD_CHECK_TIME_OTHER) LCD_newVoltage(i, -1);
      if(curTime - LCD_lastTimeUpdate[i][3] > LCD_CHECK_TIME_OTHER) LCD_newTemp(i, -1);
    }
  }
}

void a_inline LCD_setup() {
  pinMode(NEXT_SENSOR_PIN, INPUT_PULLUP);
  pinMode(PREV_SENSOR_PIN, INPUT_PULLUP);
  pinMode(STANDBY_PIN, INPUT_PULLUP);
  nextSensor_debounce.attach(NEXT_SENSOR_PIN);
  nextSensor_debounce.interval(5);
  prevSensor_debounce.attach(PREV_SENSOR_PIN);
  prevSensor_debounce.interval(5);
  standby_debounce.attach(STANDBY_PIN);
  standby_debounce.interval(5);
  LCD_switchState(LCD_STARTUP);
}

const byte LCD_splash_bits[] U8G_PROGMEM = {
  0x00, 0x00, 0x00, 0x00, 0x00, 0x00, 0x00, 0x00, 0x00, 0x00, 0x00, 0x00,
  0x00, 0x00, 0x00, 0x00, 0x00, 0x00, 0x00, 0x00, 0x00, 0x00, 0x00, 0x00,
  0x00, 0x00, 0x00, 0x00, 0x00, 0x00, 0x00, 0x00, 0x00, 0x00, 0x00, 0x00,
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  0x00, 0x00, 0x00, 0x00
};




















